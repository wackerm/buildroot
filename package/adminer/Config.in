## package/adminer/Config.in
```kconfig
config BR2_PACKAGE_ADMINER
	bool "adminer"
	help
	  Adminer is a small and simple MySQL-Administration-Tool. Similar to phpMyAdmin but lighweight and fast.

	  http://www.adminer.org
```
